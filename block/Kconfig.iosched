## block/Kconfig.iosched
```kconfig
if BLOCK

menu "IO Schedulers"

config IOSCHED_SIO
       tristate "Simple I/O scheduler"
       default y
       ---help---
         The Simple I/O scheduler is an extremely simple scheduler,
         based on noop and deadline, that relies on deadlines to
         ensure fairness. The algorithm does not do any sorting but
         basic merging, trying to keep a minimum overhead. It is aimed
         mainly for aleatory access devices (eg: flash devices).

config CFQ_GROUP_IOSCHED
	bool "CFQ Group Scheduling support"
	depends on IOSCHED_CFQ && BLK_CGROUP
	default n
	---help---
	  Enable group IO scheduling in CFQ.

choice
	prompt "Default I/O scheduler"
	default DEFAULT_CFQ
	help
	  Select the I/O scheduler which will be used by default for all
	  block devices.

    config DEFAULT_SIO
        bool "SIO" if IOSCHED_SIO=y

endchoice

config DEFAULT_IOSCHED
	string
    default "sio" if DEFAULT_SIO

endmenu

endif
```
